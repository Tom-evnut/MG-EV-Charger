VERSION ""

NS_ :

BS_:
BU_:
BO_ 2147484961 ShuntCurMsg: 8 Vector__XXX
   SG_ ShuntCur : 16|32@1- (0.001,0) [0|1] "A" Vector__XXX

BO_ 2147484962 ShuntVoltMsg1: 8 Vector__XXX
   SG_ ShuntVolt1 : 16|32@1+ (0.001,0) [0|1] "V" Vector__XXX

BO_ 2147484963 ShuntVoltMsg2: 8 Vector__XXX
   SG_ ShuntVolt2 : 16|32@1+ (0.001,0) [0|1] "V" Vector__XXX

CM_ SG_ 2147484961 ShuntCur "Shunt";
BA_DEF_ BO_ "GenMsgBackgroundColor" STRING ;
BA_DEF_ BO_ "GenMsgForegroundColor" STRING ;
BA_DEF_ BO_ "filterlabeling" INT 0 0;
BA_DEF_DEF_ "GenMsgBackgroundColor" "#ffffff";
BA_DEF_DEF_ "GenMsgForegroundColor" "#000000";
BA_DEF_DEF_ "filterlabeling" 1;
