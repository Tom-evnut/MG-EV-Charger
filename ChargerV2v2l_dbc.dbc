VERSION ""

NS_ :

BS_:
BU_: OBC
BO_ 1806 ChargerMsg4: 8 Vector__XXX

BO_ 932 ChargerMsg3: 8 Vector__XXX

BO_ 930 ChargerMsg2: 8 Vector__XXX

BO_ 927 ChargerMsg1: 8 Vector__XXX
   SG_ ChargerLvVolts : 15|8@0+ (0.125,0) [0|1] "V" Vector__XXX
   SG_ ChargerLvAmps : 39|8@0+ (0.125,0) [0|1] "A" Vector__XXX

BO_ 2147484452 ChargerMsg5: 8 Vector__XXX
   SG_ ChargerHvVolt : 15|16@0- (0.02,0) [0|1] "V" Vector__XXX

BO_ 2147484451 ChargerMsg6: 8 Vector__XXX
   SG_ ChargerPlugState : 47|8@0+ (1,0) [0|1] "" Vector__XXX

BA_DEF_ BO_ "GenMsgBackgroundColor" STRING ;
BA_DEF_ BO_ "GenMsgForegroundColor" STRING ;
BA_DEF_ BO_ "filterlabeling" INT 0 0;
BA_DEF_DEF_ "GenMsgBackgroundColor" "#ffffff";
BA_DEF_DEF_ "GenMsgForegroundColor" "#000000";
BA_DEF_DEF_ "filterlabeling" 1;
